## Kconfig
```kconfig
#
# For a description of the syntax of this configuration file,
# see build/scripts/Documentation/kbuild/kconfig-language.txt.
#
mainmenu "Speedtest SDK Configuration"

source build/Kconfig.arch
source build/Kconfig.build
source build/Kconfig.vendor
```

## build/Kconfig.arch
```kconfig
#
# For a description of the syntax of this configuration file,
# see Documentation/kbuild/kconfig-language.txt.
#

#comment "Architecture Configuration"

choice
	prompt "Architecture"
	help
		Select Architecture
	config ARM_ARCH
		bool "arm"
		help
			ARM Architecture
    config LINUX_X86_64
		bool "linux_x86_64"
		help
			Linux x86_64 Architecture
endchoice

#comment "Chip Configuration"

menu "Chip Type"
    choice
        prompt "Chip Type"
        depends on ARM_ARCH
        help
            Select Hisilicon Chip series
        config RTL8197FH
            bool "RTL8197FH"
            help
                28nm, MIPS 24Kc, 1GHz
        config HI3556V100
            bool "Hi3556v100"
            help
                CPU is Dual Core Cortex A53 and Cortex A53
        config HI3559V200
            bool "Hi3559v200"
            help
                CPU is Dual Core Cortex A7 and Cortex A7
        config SSC325
            bool "SSC325"
            help
                CPU is Single Core Cortex A7
    endchoice
endmenu

menu "ToolChain"
	choice
		prompt "Linux"
		depends on RTL8197FH || HI3559V100 || HI3556V100 || HI3559V200 || HI3556V200 || SSC325
		config LINUX_CROSS_MSDK
			bool "msdk-linux"
			depends on RTL8197FH
		config LINUX_CROSS_HISIV600
			bool "arm-hisiv600-linux"
			depends on HI3559V100 || HI3556V100
		config LINUX_CROSS_HIMIX100
			bool "arm-himix100-linux"
			depends on HI3559V200 || HI3556V200
		config LINUX_CROSS_UCLIBC_HARD_FLOAT
			bool "arm-buildroot-linux-uclibcgnueabihf"
			depends on SSC325
	endchoice
    choice
		prompt "GNU"
		depends on LINUX_X86 || LINUX_X86_64
        config LINUX_CROSS_GNU
			bool "gnu"
			depends on LINUX_X86 || LINUX_X86_64
	endchoice
endmenu
```

## build/Kconfig.build
```kconfig
#
# For a description of the syntax of this configuration file,
# see build/scripts/Documentation/kbuild/kconfig-language.txt.
#
#comment "Build Configuration"

menu "Build Configure"
	config SOFT_VERSION
		string "software verison"
	choice
		prompt "Build Type"
		default DEBUG
		config DEBUG
			bool "debug"
		config RELEASE
			bool "release"
	endchoice
	choice
		prompt "Log Level"
		depends on DEBUG
		default LOG_LEVEL_DEBUG
		config LOG_LEVEL_ERR
			bool "ERROR"
		config LOG_LEVEL_DEBUG
			bool "DEBUG"
	endchoice
    choice
		prompt "Log File"
		default LOG_FILE_OFF
        config LOG_FILE_ON
			bool "Log file on"
		config LOG_FILE_OFF
			bool "Log file off"
	endchoice
endmenu
```

## build/Kconfig.vendor
```kconfig
#
# For a description of the syntax of this configuration file,
# see Documentation/kbuild/kconfig-language.txt.
#

#comment "Vendor Configuration"

choice
	prompt "Vendor"
	help
		Select Vendor
	config OVERSEAS_LIDL
		bool "Overseas Lidl"
		help
			Overseas Lidl
	config SICHUAN_CT_MOJING
		bool "Sichuan CT Mojing"
		help
			China Telecom Sichuan Mojing
	config HUNAN_GUANGYUAN
		bool "Hunan GuangYuan"
		help
			HuNan GuangYuan PQTEC
	config BEIJING_CETC
		bool "Beijing CECT"
		help
			China Electronics Technology Group Corporation
    config SICHUAN_CMCC
		bool "Sichuan cmcc"
		help
			China Mobile Communications Group Co.,Ltd 
endchoice
```
